## boards/shields/risateno/Kconfig.defconfig
```kconfig
# Copyright (c) 2020 The ZMK Contributors
# SPDX-License-Identifier: MIT

# Not split. Each half acts as central!

config ZMK_KEYBOARD_NAME
    default "RISATENO"

config ZMK_SPLIT_ROLE_CENTRAL
    default y

config ZMK_SPLIT
    default n
```

## boards/shields/risateno/Kconfig.shield
```kconfig
# Copyright (c) 2020 The ZMK Contributors
# SPDX-License-Identifier: MIT

config SHIELD_RISATENO
    def_bool $(shields_list_contains,risateno)

config SHIELD_RISATENO_LEFT
    def_bool $(shields_list_contains,risateno_left)

config SHIELD_RISATENO_RIGHT
    def_bool $(shields_list_contains,risateno_right)
```

## config/boards/shields/RISATENO/Kconfig.defconfig
```kconfig
# Copyright (c) 2020 The ZMK Contributors
# SPDX-License-Identifier: MIT

if SHIELD_RISATENO

config ZMK_KEYBOARD_NAME
    default "RiSATENOO"

config ZMK_SPLIT
    default n

endif
```

## config/boards/shields/RISATENO/Kconfig.shield
```kconfig
 #
 # Copyright (c) 2020 The ZMK Contributors
 #
 # SPDX-License-Identifier: MIT
 #

config SHIELD_RISATENO
    def_bool $(shields_list_contains,RISATENO)
```

## config/boards/shields/corne/Kconfig.defconfig
```kconfig
if SHIELD_CORNE_LEFT || SHIELD_CORNE_RIGHT

config ZMK_KEYBOARD_NAME
    default "Corne"

config ZMK_SPLIT
    default y

endif
```

## config/boards/shields/risateno/Kconfig.defconfig
```kconfig
config ZMK_KEYBOARD_NAME
    default "RISATENO"

config ZMK_SPLIT_ROLE_CENTRAL
    default y

config ZMK_SPLIT
    default n
```
